## Kconfig
```kconfig
menu "LGFX_Fonts: GFX library selection"

    config LGFX_FONT_USE_GFX
        bool "Use LovyanGFX/M5GFX component"
        default y

    choice LGFX_FONT_GFX
        bool "GFX Library choice"
        default LGFX_FONT_USE_LOVYANGFX

    config LGFX_FONT_USE_LOVYANGFX
        bool "LovyanGFX"

    config LGFX_FONT_USE_M5GFX
        bool "M5GFX"

    endchoice

endmenu
```

## examples/build_test/sdkconfig.defaults
```kconfig
CONFIG_MBEDTLS_CERTIFICATE_BUNDLE=n
CONFIG_MBEDTLS_CERTIFICATE_BUNDLE_DEFAULT_FULL=n
CONFIG_COMPILER_DISABLE_DEFAULT_ERRORS=y
CONFIG_PARTITION_TABLE_SINGLE_APP_LARGE=y
CONFIG_PARTITION_TABLE_CUSTOM_FILENAME="partitions.csv"
CONFIG_PARTITION_TABLE_FILENAME="partitions_singleapp_large.csv"
CONFIG_PARTITION_TABLE_OFFSET=0x8000
CONFIG_PARTITION_TABLE_MD5=y
```
